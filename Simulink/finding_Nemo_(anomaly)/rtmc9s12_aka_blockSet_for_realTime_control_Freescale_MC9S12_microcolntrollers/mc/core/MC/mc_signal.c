/******************************************************************************/
/*                                                                            */
/* Auxilliary functions, signalling of error codes                            */
/*                                                                            */
/* Author: F. Wornle (FW-mn-yr)                                               */
/* Latest change: fw-07-09                                                    */
/*                                                                            */
/******************************************************************************/

/* Model dependent constants -- generated by 'gen_mc_defines_h.m' */
#include "mc_defines.h"

#include "mc_lcd.h"               /* LCD_blank1, LCD_blank2, etc. */
#include "bsp_sci.h"              /* RDRF_mask, BAUD_xxx, etc. */
#include "mc_debugMsgs.h"         /* DEBUG_TX_IRQ */



#if LCDUSE4ERRORS == 1
/* ============================================================================== */
/* 'display' unsigned integer on the LCD                                          */
/* ============================================================================== */
void dispLCD_uint(unsigned int n, const char *myText, int line) {

   int            i,
                  j,
                  k,
                  l;
   static char    myLCDtxt[16]="                ";
   unsigned int   myOut[8];


   /* copy text to output buffer */
   i=0;
   while(myText[i]!=0) {

      myLCDtxt[i]=myText[i++];

   }

   /* determine magnitude of number to be displayed */
   k=10;
   while(n/k>=10) {

      k*=10;

   }

   /* determine all digits */
   j=0;
   while(k>=1) {

      myOut[j]=(unsigned int)(n/k);
      n=n-myOut[j++]*k;
      k/=10;

   }

   /* display... */
   for(l=0; l<j; l++) {

      myLCDtxt[i+l]='0'+myOut[l];

   }

   if(line==0) {

      LCD_blank1();

   }
   else {

      LCD_blank2();

   }

   writeLine(myLCDtxt, line);

}
/* ============================================================================== */
#endif /* LCDUSE4ERRORS  */



/* ============================================================================== */
/* flash on-board LED                                                             */
/* ============================================================================== */
void wait(void) {

   ;                  /* dummy function call; used to extend LED display duration */

}

void blinky(unsigned long i) {

   unsigned long  k;

   #if ((TARGET_BOARD == BSP_DRAGON12PLUS) || (TARGET_BOARD == BSP_DRAGON12))
   /* Dragon-12plus and Dragon-12 */
   DDRB|=0x01;                /* LED enabled */
   PORTB|=0x01;                  /* LED on  */
   for(k=0; k<i; k++) {

      wait();

   }     /* delay   */
   PORTB^=0x01;                  /* LED off */
   for(k=0; k<i; k++) {

      wait();

   }     /* delay   */
   #endif

   #if ((TARGET_BOARD == BSP_MINIDRAGONPLUS) | (TARGET_BOARD == BSP_MINIDRAGONPLUS2))
   /* BSP_MINIDRAGONPLUS+ */
   DDRH|=0x01;                        /* first segment is an output */
   PTH|=0x01;                    /* first segment on  */
   for(k=0; k<i; k++) {

      wait();

   }     /* delay   */
   PTH^=0x01;                          /* first segment off */
   for(k=0; k<i; k++) {

      wait();

   }     /* delay   */
   #endif
}
/* ============================================================================== */


/* ============================================================================== */
/* display a digit (0 - 9) on the 7-segment display (Dragon-12)                   */
/* ============================================================================== */

#if ((TARGET_BOARD == BSP_DRAGON12PLUS) || (TARGET_BOARD == BSP_DRAGON12))
/* Dragon-12plus and Dragon-12 */
void displayDigit(int dig) {

   /* Dragon-12 based targets */
   switch(dig) {

      case -1:
         PORTB=0x40;   /* - */
         break;
      case 0:
         PORTB=0x3f;
         break;
      case 1:
         PORTB=0x06;
         break;
      case 2:
         PORTB=0x5b;
         break;
      case 3:
         PORTB=0x4f;
         break;
      case 4:
         PORTB=0x66;
         break;
      case 5:
         PORTB=0x6d;
         break;
      case 6:
         PORTB=0x7d;
         break;
      case 7:
         PORTB=0x07;
         break;
      case 8:
         PORTB=0x7f;
         break;
      default:
         PORTB=0x6f;   /* 9 and all other cases... */
         break;

   }

}
#endif


/* ============================================================================== */
/* display a digit (0 - 9) on the 7-segment display (BSP_MINIDRAGONPLUS+)                 */
/* ============================================================================== */

#if ((TARGET_BOARD == BSP_MINIDRAGONPLUS) | (TARGET_BOARD == BSP_MINIDRAGONPLUS2))
void displayDigit(int dig) {

   /* BSP_MINIDRAGONPLUS+ based targets only */
   switch(dig) {

      case -1:
         PTH=0xc0;   /* -  (?? not checked... fw-07-07) */
         break;
      case 0:
         PTH=0xbf;
         break;
      case 1:
         PTH=0x06;
         break;
      case 2:
         PTH=0xdb;
         break;
      case 3:
         PTH=0xcf;
         break;
      case 4:
         PTH=0xe6;
         break;
      case 5:
         PTH=0xed;
         break;
      case 6:
         PTH=0xfd;
         break;
      case 7:
         PTH=0x07;
         break;
      case 8:
         PTH=0xff;
         break;
      default:
         PTH=0xe7;   /* 9 and all other cases... */
         break;

   }

}
#endif /* TARGET_BOARD */
/* ============================================================================== */


/* ============================================================================== */
/* 'display' error number on the LED                                              */
/* ============================================================================== */
void sigLED(int ErrorNumber) {

   unsigned long  k;
   int            i,
                  j;
   static char    myLCDtxt[16]="Error:          ";


   /* display ErrorNumber (LED) :    */
   /* long - (tens) - long - (ones)  */

   j=(int)(((float)(ErrorNumber)+0.5)/10.0);

   #if LCDUSE4ERRORS == 1
   myLCDtxt[7]=(char)('0'+j);
   #else
   blinky(150000);
   #if ((TARGET_BOARD == BSP_MINIDRAGONPLUS) | (TARGET_BOARD == BSP_MINIDRAGONPLUS2))
   // BSP_MINIDRAGONPLUS
   displayDigit(j);                     /* tens */
   #else
   for(i=0; i<j; i++) {

      blinky(70000);

   }     /* tens */
   #endif
   for(k=0; k<100000; k++) {

      wait();

   }
   blinky(150000);
   #endif

   j=(int)(ErrorNumber-j*10);

   #if LCDUSE4ERRORS == 1
   myLCDtxt[8]=(char)('0'+j);
   LCD_blank1();
   LCD_blank2();
   writeLine(myLCDtxt, 0);
   #else
   #if ((TARGET_BOARD == BSP_MINIDRAGONPLUS) | (TARGET_BOARD == BSP_MINIDRAGONPLUS2))
   // BSP_MINIDRAGONPLUS
   displayDigit(j);                     /* ones */
   #else
   for(i=0; i<j; i++) {

      blinky(70000);

   }     /* ones */
   #endif
   for(k=0; k<100000; k++) {

      wait();

   }
   #endif
}
/* ============================================================================== */


/* ============================================================================== */
/* terminate MC program and 'display' error number on the LED                     */
/* ============================================================================== */
void abort_LED(int ErrorNumber) {

   unsigned long  k;

   asm sei                       /* disable all interrupts */


   /* flush debug messaging buffer */
   #ifdef DEBUG_TX_IRQ

   TIE &= ~0x80;                 /* disable T7 interrupt */
   CRGINT_RTIE = 0;              /* disable RTI interrupt */
   SCI1CR2 = 0;                  /* disable SCI1 interrupts */
   TFLG1_C0F = 0;                /* interrupt used by radioClient/radioServer */
   asm cli                       /* re-enable all remaining interrupts (should only be SCI0_TX) */

   SCI0_FlushBuffer();
   SCI0_OutChar('*');
   SCI0_FlushBuffer();
   
   asm sei                       /* disable all interrupts */
   
   #endif


   /* display ErrorNumber (LED) */
   sigLED(ErrorNumber);

   /* dimmed light...           */
   while(1) {

      blinky(100);
      for(k=0; k<1000; k++) {

         wait();

      }

   }

}
/* ============================================================================== */
